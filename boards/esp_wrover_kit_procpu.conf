## boards/rpi_pico2_rp2350a_m33_w.conf
```kconfig
# Enable USB CDC for shell
CONFIG_SERIAL=y
CONFIG_CONSOLE=y
CONFIG_UART_CONSOLE=y
CONFIG_USB_DEVICE_STACK=y
CONFIG_USB_DEVICE_INITIALIZE_AT_BOOT=y
```
